## board/keithkoep/trizeps7/Kconfig
```kconfig
#trizeps7 Kconfig file

if TARGET_TRIZEPS7

config SYS_BOARD
    default "trizeps7"

config SYS_VENDOR
    default "keithkoep"

config SYS_CONFIG_NAME
    default "trizeps7"

endif
```
